/*LWM 10K*/
/ {
	fragment {
			target-path = "/";
			__overlay__ {

			bat1: battery1 {
				compatible = "simple-battery";
				charge-full-design-microamp-hours = <4934000>;
				charge-term-current-microamp = <256000>;
				constant_charge_voltage_max_microvolt = <4432000>;
				factory-internal-resistance-micro-ohms = <115000>;
				voltage-min-design-microvolt = <3456000>;
				ocv-capacity-celsius = <20>;
				ocv-capacity-table-0 = <4413000 100>, <4352000 95>, <4295000 90>,
							<4235000 85>, <4176000 80>, <4118000 75>,
							<4065000 70>, <4016000 65>, <3968000 60>,
							<3914000 55>, <3870000 50>, <3842000 45>,
							<3820000 40>, <3802000 35>, <3786000 30>,
							<3767000 25>, <3747000 20>, <3723000 15>,
							<3692000 10>, <3681000 5>, <3400000 0>;
				voltage-temp-table = <1000097 650>, <954328 700>, <903668 750>,
							<849122 800>, <792187 850>, <734249 900>,
							<676614 950>, <620986 1000>, <568639 1050>,
							<520143 1100>, <475938 1150>, <436313 1200>,
							<401216 1250>, <370308 1300>, <343425 1350>,
							<320171 1400>, <300068 1450>, <282780 1500>,
							<267953 1550>, <255247 1600>, <244533 1650>,
							<235371 1700>, <227491 1750>, <220732 1800>,
							<214944 1850>, <209966 1900>, <205642 1950>;
				capacity-temp-table = <45 99>, <25 100>, <10 100>, <0 93>, <(-10) 86>, <(-20) 72>;
				resistance-temp-table = <45 97>, <25 100>, <10 166>, <0 1000>, <(-10) 1086>, <(-20) 1191>;
				charge-sdp-current-microamp = <480000 500000>;
				charge-dcp-current-microamp = <2200000 2200000>;
				charge-cdp-current-microamp = <1500000 1500000>;
				charge-unknown-current-microamp = <1200000 1200000>;
				charge-fchg-current-microamp = <3400000 2000000>; /*1700 1000*/
				cm-dcp-jeita-temp-table = <900 901 0 3980000 0 3980000>,
					<1000 1010 364000 3980000 364000 3980000>,
					<1050 1080 2200000 4432000 1425000 4180000>,
					<1120 1150 2200000 4432000 2200000 4432000>,
					<1160 1190 2200000 4432000 2200000 4432000>,
					<1450 1420 2200000 4432000 2200000 4432000>,
					<1530 1500 1425000 4112000 1425000 4112000>;
				cm-sdp-jeita-temp-table = <900 901 0 3980000 0 3980000>,
					<1000 1030 364000 3980000 364000 3980000>,
					<1050 1080 480000 4432000 480000 4432000>,
					<1120 1150 480000 4432000 480000 4432000>,
					<1160 1190 480000 4432000 480000 4432000>,
					<1450 1420 480000 4432000 480000 4432000>,
					<1530 1500 480000 4112000 480000 4112000>;
				cm-cdp-jeita-temp-table = <900 901 0 3980000 0 3980000>,
					<1000 1030 364000 3980000 364000 3980000>,
					<1050 1080 480000 4432000 480000 4432000>,
					<1120 1150 1000000 4432000 1000000 4432000>,
					<1160 1190 1500000 4432000 1500000 4432000>,
					<1450 1420 1500000 4432000 1500000 4432000>,
					<1530 1500 1000000 4112000 1000000 4112000>;
				cm-unknown-jeita-temp-table = <900 901 0 3980000 0 3980000>,
					<1000 1030 364000 3980000 364000 3980000>,
					<1050 1080 480000 4432000 480000 4432000>,
					<1120 1150 1000000 4432000 1000000 4432000>,
					<1160 1190 1200000 4432000 1200000 4432000>,
					<1450 1420 1200000 4432000 1200000 4432000>,
					<1530 1500 1000000 4112000 1000000 4112000>;
				cm-fchg-jeita-temp-table = <900 901 0 3980000 0 3980000>,/* <-2 invalid */
					<1000 1010 728000 3980000 728000 3980000>,/* -2-0 invalid */
					<1050 1060 2374000 4432000 1424000 4180000>,/* 0-5 */
					<1120 1130 2374000 4432000 2374000 4432000>,/* 5-12 */
					<1160 1190 3324000 4432000 2374000 4180000>,/* 12-16 */
					<1220 1230 3000000 4432000 3000000 4432000>,/* 16-22 */
					<1340 1330 3400000 4432000 3180000 4180000>,/* 22-34 */
					<1370 1360 3180000 4432000 3180000 4432000>,/* 34-37 */
					<1400 1390 2800000 4432000 2800000 4432000>,/* 37-40 */
					<1420 1410 2660000 4432000 2660000 4432000>,/* 40-42 */
					<1450 1420 960000 4432000 960000 4432000>,/* 42-45 invalid */
					<1530 1500 960000 4112000 960000 4112000>;/* 45-53 invalid */
			};
		};
	};
};
