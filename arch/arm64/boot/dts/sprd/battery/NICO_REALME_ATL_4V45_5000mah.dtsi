/*ATL 10K*/
/ {
	fragment {
			target-path = "/";
			__overlay__ {

			bat: battery {
				compatible = "simple-battery";
				charge-full-design-microamp-hours = <5038000>;
				charge-term-current-microamp = <256000>;
				constant_charge_voltage_max_microvolt = <4432000>;
				factory-internal-resistance-micro-ohms = <110000>;
				voltage-min-design-microvolt = <3455000>;
				ocv-capacity-celsius = <20>;
				ocv-capacity-table-0 = <4406000 100>, <4333000 95>, <4272000 90>,
							<4211000 85>, <4151000 80>, <4095000 75>,
							<4043000 70>, <3996000 65>, <3953000 60>,
							<3906000 55>, <3857000 50>, <3830000 45>,
							<3810000 40>, <3793000 35>, <3781000 30>,
							<3765000 25>, <3745000 20>, <3722000 15>,
							<3690000 10>, <3677000 5>, <3400000 0>;
				voltage-temp-table = <1000097 650>, <954328 700>, <903668 750>,
							<849122 800>, <792187 850>, <734249 900>,
							<676614 950>, <620986 1000>, <568639 1050>,
							<520143 1100>, <475938 1150>, <436313 1200>,
							<401216 1250>, <370308 1300>, <343425 1350>,
							<320171 1400>, <300068 1450>, <282780 1500>,
							<267953 1550>, <255247 1600>, <244533 1650>,
							<235371 1700>, <227491 1750>, <220732 1800>,
							<214944 1850>, <209966 1900>, <205642 1950>;
				capacity-temp-table = <45 99>, <25 100>, <10 99>, <0 91>, <(-10) 87>, <(-20) 72>;
				resistance-temp-table = <45 85>, <25 100>, <10 168>, <0 1045>, <(-10) 1118>, <(-20) 1255>;
				charge-sdp-current-microamp = <480000 500000>;
				charge-dcp-current-microamp = <2200000 2200000>;
				charge-cdp-current-microamp = <1500000 1500000>;
				charge-unknown-current-microamp = <1200000 1200000>;
				charge-fchg-current-microamp = <1700000 1000000>; /*1700 1000*/
				cm-dcp-jeita-temp-table = <900 901 0 3980000 0 3980000>,
					<1000 1010 364000 3980000 364000 3980000>,
					<1050 1080 2200000 4432000 1425000 4180000>,
					<1120 1150 2200000 4432000 2200000 4432000>,
					<1160 1190 2200000 4432000 2200000 4432000>,
					<1450 1420 2200000 4432000 2200000 4432000>,
					<1530 1500 1425000 4112000 1425000 4112000>;
				cm-sdp-jeita-temp-table = <900 901 0 3980000 0 3980000>,
					<1000 1030 364000 3980000 364000 3980000>,
					<1050 1080 480000 4432000 480000 4432000>,
					<1120 1150 480000 4432000 480000 4432000>,
					<1160 1190 480000 4432000 480000 4432000>,
					<1450 1420 480000 4432000 480000 4432000>,
					<1530 1500 480000 4112000 480000 4112000>;
				cm-cdp-jeita-temp-table = <900 901 0 3980000 0 3980000>,
					<1000 1030 364000 3980000 364000 3980000>,
					<1050 1080 480000 4432000 480000 4432000>,
					<1120 1150 1000000 4432000 1000000 4432000>,
					<1160 1190 1500000 4432000 1500000 4432000>,
					<1450 1420 1500000 4432000 1500000 4432000>,
					<1530 1500 1000000 4112000 1000000 4112000>;
				cm-unknown-jeita-temp-table = <900 901 0 3980000 0 3980000>,
					<1000 1030 364000 3980000 364000 3980000>,
					<1050 1080 480000 4432000 480000 4432000>,
					<1120 1150 1000000 4432000 1000000 4432000>,
					<1160 1190 1200000 4432000 1200000 4432000>,
					<1450 1420 1200000 4432000 1200000 4432000>,
					<1530 1500 1000000 4112000 1000000 4112000>;
				cm-fchg-jeita-temp-table = <900 901 0 3980000 0 3980000>,/* <-2 invalid */
					<1000 1010 364000 3980000 364000 3980000>,/* -2-0 invalid */
					<1050 1060 1187000 4432000 712000 4180000>,/* 0-5 */
					<1120 1130 1187000 4432000 1187000 4432000>,/* 5-12 */
					<1160 1190 1662000 4432000 1187000 4180000>,/* 12-16 */
					<1220 1230 1500000 4432000 1500000 4432000>,/* 16-22 */
					<1340 1330 1700000 4432000 1590000 4180000>,/* 22-34 */
					<1370 1360 1590000 4432000 1590000 4432000>,/* 34-37 */
					<1400 1390 1400000 4432000 1400000 4432000>,/* 37-40 */
					<1420 1410 1330000 4432000 1330000 4432000>,/* 40-42 */
					<1450 1420 480000 4432000 480000 4432000>,/* 42-45 invalid */
					<1530 1500 480000 4112000 480000 4112000>;/* 45-53 invalid */
			};
		};
	};
};
